## ai_agents/esp32-client/Respeaker-xvf3800/managed_components/espressif__esp-dsp/Kconfig
```kconfig
menu "DSP Library"


config DSP_OPTIMIZATIONS_SUPPORTED
   bool
   default y
   depends on IDF_TARGET_ESP32 || IDF_TARGET_ESP32S3 || IDF_TARGET_ESP32P4

choice DSP_OPTIMIZATION
   bool "DSP Optimization"
   default DSP_OPTIMIZED if DSP_OPTIMIZATIONS_SUPPORTED
   default DSP_ANSI
   help
      An ANSI C version could be used for verification and debug purpose,
      or for chips where an optimized version is not available.

config DSP_ANSI
   bool "ANSI C"
config DSP_OPTIMIZED
   bool "Optimized"
   depends on DSP_OPTIMIZATIONS_SUPPORTED
endchoice

config DSP_OPTIMIZATION
   int
   default 0 if DSP_ANSI
   default 1 if DSP_OPTIMIZED

choice DSP_MAX_FFT_SIZE
   bool "Maximum FFT length"
   default DSP_MAX_FFT_SIZE_4096
   help
      This is default FFT size for internal usage.

config DSP_MAX_FFT_SIZE_512
   bool "512"
config DSP_MAX_FFT_SIZE_1024
   bool "1024"
config DSP_MAX_FFT_SIZE_2048
   bool "2048"
config DSP_MAX_FFT_SIZE_4096
   bool "4096"
config DSP_MAX_FFT_SIZE_8192
   bool "8192"
config DSP_MAX_FFT_SIZE_16384
   bool "16384"
config DSP_MAX_FFT_SIZE_32768
   bool "32768"
endchoice

config DSP_MAX_FFT_SIZE
   int
   default 512 if DSP_MAX_FFT_SIZE_512
   default 1024 if DSP_MAX_FFT_SIZE_1024
   default 2048 if DSP_MAX_FFT_SIZE_2048
   default 4096 if DSP_MAX_FFT_SIZE_4096
   default 8192 if DSP_MAX_FFT_SIZE_8192
   default 16384 if DSP_MAX_FFT_SIZE_16384
   default 32768 if DSP_MAX_FFT_SIZE_32768

endmenu
```

## ai_agents/esp32-client/Respeaker-xvf3800/managed_components/espressif__esp-dsp/applications/azure_board_apps/apps/kalman_filter/main/Kconfig.projbuild
```kconfig
menu "Demo user configuration"
    choice
        prompt "Select 3D object"
        config 3D_OBJECT_CUBE
            bool "3D cube"
            help
                3D graphics to be displayed is cube

        config 3D_OBJECT_ESP_LOGO
            bool "3D ESP Logo"
            help
                3D graphics to be displayed is ESP Logo

        config 3D_OBJECT_CUSTOM
            bool "User-defined graphics"
            help
                3D graphics to be displayed is a user-defined graphics
    endchoice
endmenu
```

## ai_agents/esp32-client/Respeaker-xvf3800/managed_components/espressif__esp-dsp/examples/kalman/sdkconfig.defaults
```kconfig
#
# DSP Library
#
# CONFIG_DSP_ANSI is not set
CONFIG_DSP_OPTIMIZED=y
# CONFIG_DSP_MAX_FFT_SIZE_512 is not set
# CONFIG_DSP_MAX_FFT_SIZE_1024 is not set
# CONFIG_DSP_MAX_FFT_SIZE_2048 is not set
CONFIG_DSP_MAX_FFT_SIZE_4096=y
# CONFIG_DSP_MAX_FFT_SIZE_8192 is not set
# CONFIG_DSP_MAX_FFT_SIZE_16384 is not set
# CONFIG_DSP_MAX_FFT_SIZE_32768 is not set
CONFIG_DSP_MAX_FFT_SIZE=4096
# end of DSP Library

#
# ESP System Settings
#
CONFIG_PARTITION_TABLE_OFFSET=0x9000
CONFIG_ESP_INT_WDT=n
CONFIG_ESP_TASK_WDT=n
# end of ESP System Settings
```

## ai_agents/esp32-client/Respeaker-xvf3800/managed_components/espressif__jsmn/Kconfig
```kconfig
menu "jsmn"


    config JSMN_PARENT_LINKS
        bool "Enable parent links"
        default n
        help
            You can access parent node of parsed json

    config JSMN_STRICT
        bool "Enable strict mode"
        default n
        help
            In strict mode primitives are: numbers and booleans

    config JSMN_STATIC
        bool "Declare JSMN API as static"
        default node
        help
            Declar JSMN API as static (instead of extern)

endmenu
```

## ai_agents/esp32-client/Respeaker-xvf3800/managed_components/espressif__nghttp/Kconfig
```kconfig
menu "NGHTTP configuration"

    config ESP_NGHTTP2_INBOUND_BUFFER_LENGTH
        int "Nghttp2 inbound buffer length"
        default 4096
        help
            Set the size of the inbound buffer for nghttp2. This buffer is used to store incoming HTTP/2 frames.
            The default value is 16KB as per nghttp2 library configuration but here we have set it to 4KB. The
            receive buffer gets placed on the stack and hence adjust this value based on your application needs
            and available stack size.

endmenu
```

## third_party/libwebsockets/Kconfig
```kconfig
menu "Libwebsockets"

config LWS_MODEL_NAME
	string "Model name of device firmware is for"
	default "lws"

config LWS_IS_FACTORY_APPLICATION
	bool "Is this application is designed for the FACTORY flash slot"
	default "n"

config LWS_OTA_SERVER_FQDN
	depends on LWS_IS_FACTORY_APPLICATION
	string "Domain name of OTA update server, eg, warmcat.com"
	default ""

config LWS_OTA_SERVER_BASE_URL
	depends on LWS_IS_FACTORY_APPLICATION
	string "Base URL on OTA update server, eg, /esp32-ota (model is added)"
	default "/esp32-ota"

config LWS_OTA_SERVER_UPLOAD_USER
	depends on LWS_IS_FACTORY_APPLICATION
	string "User to scp to upload server with"
	default "root"

config LWS_OTA_SERVER_UPLOAD_PATH
	depends on LWS_IS_FACTORY_APPLICATION
	string "Path served in upload server (eg, \"/var/www/libwebsockets.org\""
	default "/var/www/libwebsockets.org"

endmenu
```
